## arch/x86/Kconfig
```kconfig
# Select 32 or 64 bit
#
#
config LITTLE_ENDIAN
        def_bool y

config PAGE_SIZE
        int
	default 4096

config MMU
        def_bool y

config HOTPLUG_CPU
        def_bool y
        prompt "Support for hot-pluggable CPUs"
        depends on SMP
        help
          Say Y here to be able to turn CPUs off and on. CPUs
          can be controlled through /sys/devices/system/cpu/cpu#.
          Say N if you want to disable CPU hotplug.

config BITS
	int
        default 32 if X86_32
        default 64 if X86_64

config 64BIT
	bool 
	default ARCH != "i386"
	---help---
	  Say yes to build a 64-bit - formerly known as x86_64
	  Say no  to build a 32-bit - formerly known as i386

config X86_32
	def_bool y
	depends on !64BIT

config X86_64
	def_bool y
	depends on 64BIT

### Arch settings
config X86
	def_bool y
	select ARCH_HAS_FAST_MULTIPLIER
#	select CONFIG_MODULES
#	select ARCH_SUPPORTS_NUMA_BALANCING if X86_64
#	select ARCH_SUPPORTS_INT128 if X86_64
	select HAVE_EFFICIENT_UNALIGNED_ACCESS
	select HAVE_ALIGNED_STRUCT_PAGE 
	select DCACHE_WORD_ACCESS
	select HAVE_CC_STACKPROTECTOR

config ARCH_DEFCONFIG
	string
	default "arch/x86/configs/i386_defconfig" if X86_32
	default "arch/x86/configs/x86_64_defconfig" if X86_64

config GENERIC_BUG
	def_bool y
	depends on BUG
	select GENERIC_BUG_RELATIVE_POINTERS if X86_64

config GENERIC_BUG_RELATIVE_POINTERS
	bool

config ARCH_HAS_CPU_RELAX
	def_bool y

source "arch/x86/Kconfig.cpu"
```

## arch/x86/configs/x86_64_defconfig
```kconfig
CONFIG_MMU=y
CONFIG_MEMORY_HOTPLUG=y
CONFIG_MEMORY_HOTREMOVE=y
CONFIG_HOTPLUG_CPU=y
CONFIG_MODULES=y
CONFIG_PAGE_SIZE=4096
CONFIG_LITTLE_ENDIAN=y
```

## scripts/Kconfig.bindings
```kconfig
config SUPPORT_LANGUAGE
        bool "Language Binding Support"
        default y

config SUPPORT_JAVA
        bool "Enable API bindings for Java"
        depends on SUPPORT_LANGUAGE
        default y

config SUPPORT_PYTHON
        bool "Enable API bindings for Python (EXPERIMENTAL)"
        depends on SUPPORT_LANGUAGE
        default y
```

## scripts/Kconfig.debug
```kconfig
config DEBUG_INFO
	bool "Enable debug info"
	default y if DEBUG = "1"
	help
	This option causes the package to be built with full debugging 
	information included. You'll need that information if you want to 
	debug the package with gdb. You may also want to enable 
	CONFIG_FRAME_POINTER if you plan to use gdb.

config DEBUG_SECTION_MISMATCH
	bool "Trigger additional mismatches with less inlining"	
	default n
	depends on DEBUG_INFO
	help
	We trigger additional mismatches with less inlining

config DEBUG_LIST                                                               
        bool "Debug linked list manipulation"
	default y
	depends on DEBUG_INFO
        help
          Enable this to turn on extended checks in the linked-list
          walking routines.

config DEBUG_HASH
	bool "Debug hash table manupulation"
	default y
	depends on DEBUG_INFO
	help
	  Enable this to turn on extended checks in the hash table warlking
          routines

config DEBUG_MEMGENERIC
        bool "Debug memory generics"                                               
        default y                                                               
        depends on DEBUG_INFO
        help                                                                    
          Enable this to turn on extended checks in the memory gen. routines.   
                                                                                
          If unsure, say N.

config DEBUG_MEMPAGE
        bool "Debug memory pages"
        default y
        depends on DEBUG_INFO
        help
          Enable this to turn on extended checks in the memory pages routines.

          If unsure, say N.

config DEBUG_MEMPOOL
        bool "Debug memory pools"
	default y
        depends on DEBUG_INFO
        help
          Enable this to turn on extended checks in the memory pool routines.

          If unsure, say N.

config DEBUG_MEMSTACK
        bool "Debug memory stack"
        default y
        depends on DEBUG_INFO
        help
          Enable this to turn on extended checks in the memory stack routines.
          If unsure, say N.


config LOGGING                                                           
        bool "Enable log functions"                                             
        default y                                                               
        help                                                                    
          Say Y if you want to enable log functions, such as                    
          print_dbg, print_info, print_warn, print_err.                         
          If you say N here, those functions are not compiled.                  
                                                                                
config LOGGING_TIME                                                             
        bool "Show timing information on log functions"                         
        default y                                                               
        depends on LOGGING                                               
        help                                                                    
          Selecting this option causes timing information to be                 
          included in log output.

config LOGGING_FUNC
	bool "Show function name on log"
	default n
	depends on LOGGING
	help
	  Selecting this option causes function name to be included in log
```

## scripts/Kconfig.modules
```kconfig
config MODULES
        bool "Enable loadable module support"
        option modules
        help
          Package modules are small pieces of compiled code which can
          be inserted in the running software, rather than being
          permanently built into the package.  If you say Y here,
          many parts of the package can be built as modules (by
          answering M instead of Y where indicated): this is most
          useful for infrequently used options which are not required
          for use.  For more information, see the man pages for
          modprobe, lsmod, modinfo, insmod and rmmod.

          If you say Y here, you will need to run "make
          modules_install" to put the modules under /$prefix/lib/modules/ .

          If unsure, say Y.

config MODVERSIONS
        bool "Module versioning support"
	depends on MODULES
	default n
        help
          Usually, you have to use modules compiled with your package.
          Saying Y here makes it sometimes possible to use modules
          compiled for different packages, by adding enough information
          to the modules to (hopefully) spot any changes which would
          make them incompatible with the software you are running.  If
          unsure, say N.

config MODULE_SRCVERSION_ALL
        bool "Source checksum for all modules"
	depends on MODULES
        help
          Modules which contain a MODULE_VERSION get an extra "srcversion"
          field inserted into their modinfo section, which contains a
          sum of the source files which made it.  This helps maintainers
          see exactly which source was used to build a module (since
          others sometimes change the module source without updating
          the version).  With this option, such a "srcversion" field
          will be created for all modules.  If unsure, say N.
```

## scripts/package/Kconfig
```kconfig
config DUMMY_MODULES
        bool "DUMMY Package Support"
	depends on MODULES
	default y
        help
          Package modules are small pieces of compiled code which can
          be inserted in the running software, 

config DUMMY_MODULE1
        bool "Enable DUMMY_MODULE1 (EXPERIMENTAL)"
	depends on DUMMY_MODULES
	default n
        help
          Usually, you have to use modules compiled with your package.
          Saying Y here makes it sometimes possible to use modules
          compiled for different packages, by adding enough information
          to the modules to (hopefully) spot any changes which would
          make them incompatible with the software you are running.  If
          unsure, say N.

config DUMMY_FEATURES
        bool "DUMMY Features Support"
	depends on MODULES
	default y
        help
          Package modules are small pieces of compiled code which can
          be inserted in the running software, 

config DUMMY_FEATURE1
        bool "Enable DUMMY_FEATURE1"
	depends on DUMMY_FEATURES
	default n
        help
          Sample feature
```
